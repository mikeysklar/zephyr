/*
 * Copyright (c) 2026 Espressif Systems (Shanghai) Co., Ltd.
 *
 * SPDX-License-Identifier: Apache-2.0
 */

/dts-v1/;

#include <espressif/esp32s31/esp32s31_common.dtsi>
#include <espressif/partitions_0x2000_default_16M.dtsi>

/ {
	model = "Espressif ESP32-S31-Korvo-1";
	compatible = "espressif,esp32s31";

	chosen {
		zephyr,sram = &sramhp;
		zephyr,flash = &flash0;
		zephyr,code-partition = &slot0_partition;
	};
};

/* ESP32-S31-WROOM-3 module: 16 MB flash + 16 MB PSRAM.
 * Confirmed on real hardware via esptool flash-id: manufacturer 0x46,
 * device 0x4018, 16 MB.
 */
&flash0 {
	reg = <0x0 DT_SIZE_M(16)>;
	ranges = <0x0 0x0 DT_SIZE_M(16)>;
};
