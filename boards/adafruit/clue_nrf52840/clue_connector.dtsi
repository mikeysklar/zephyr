/*
 * Copyright (c) 2025 Adafruit Industries LLC
 *
 * SPDX-License-Identifier: Apache-2.0
 */

/ {
	clue_header: connector {
		compatible = "adafruit-clue";
		#gpio-cells = <2>;
		gpio-map-mask = <0xffffffff 0xffffffc0>;
		gpio-map-pass-thru = <0 0x3f>;
		gpio-map = <0 0 &gpio0 4 0>,	/* P0 */
			   <1 0 &gpio0 5 0>,	/* P1 */
			   <2 0 &gpio0 3 0>,	/* P2 */
			   <3 0 &gpio0 28 0>,	/* P3 */
			   <4 0 &gpio0 2 0>,	/* P4 */
			   <5 0 &gpio1 2 0>,	/* P5 */
			   <6 0 &gpio1 9 0>,	/* P6 */
			   <7 0 &gpio0 7 0>,	/* P7 */
			   <8 0 &gpio1 7 0>,	/* P8 */
			   <9 0 &gpio0 27 0>,	/* P9 */
			   <10 0 &gpio0 30 0>,	/* P10 */
			   <11 0 &gpio1 10 0>,	/* P11 */
			   <12 0 &gpio0 31 0>,	/* P12 */
			   <13 0 &gpio0 8 0>,	/* P13 */
			   <14 0 &gpio0 6 0>,	/* P14 */
			   <15 0 &gpio0 26 0>,	/* P15 */
			   <16 0 &gpio0 29 0>,	/* P16 */
			   <17 0 &gpio1 1 0>,	/* P17 */
			   <18 0 &gpio0 16 0>,	/* P18 */
			   <19 0 &gpio0 25 0>,	/* P19 */
			   <20 0 &gpio0 24 0>;	/* P20 */
	};
};
