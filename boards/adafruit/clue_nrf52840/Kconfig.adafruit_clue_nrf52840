## boards/adafruit/clue_nrf52840/board.yml
```yaml
board:
  name: adafruit_clue_nrf52840
  full_name: CLUE nRF52840 Express
  vendor: adafruit
  socs:
    - name: nrf52840
      variants:
        - name: uf2
```

## boards/espressif/esp32s31_korvo1/Kconfig.esp32s31_korvo1
```kconfig
# Copyright (c) 2026 Espressif Systems (Shanghai) Co., Ltd.
# SPDX-License-Identifier: Apache-2.0

config BOARD_ESP32S31_KORVO1
	select SOC_ESP32S31
	select SOC_ESP32S31_REV_0_0
```

## boards/espressif/esp32s31_korvo1/board.yml
```yaml
board:
  name: esp32s31_korvo1
  full_name: ESP32-S31-Korvo-1
  vendor: espressif
  socs:
  - name: esp32s31
```

## boards/espressif/esp32s31_korvo1/esp32s31_korvo1_defconfig
```kconfig
# Copyright (c) 2026 Espressif Systems (Shanghai) Co., Ltd.
# SPDX-License-Identifier: Apache-2.0

CONFIG_ESP_SIMPLE_BOOT=y
```

## drivers/i2s/Kconfig.sdl
```kconfig
# SDL based emulated I2S configuration options

# Copyright (c) 2026 Adafruit Industries
# SPDX-License-Identifier: Apache-2.0

config I2S_SDL
	bool "SDL based emulated I2S"
	default y
	depends on DT_HAS_ZEPHYR_I2S_SDL_ENABLED
	select HAS_SDL
	help
	  Enable SDL based emulated I2S driver for native_sim.
	  Audio is played through SDL2 audio subsystem and sample
	  values are emitted as Perfetto counter tracks.
```

## dts/bindings/bluetooth/infineon,cyw43-bt-hci.yaml
```yaml
# Copyright (c) 2025 Dave Rensberger
# Copyright (c) 2026 Adafruit Industries
# SPDX-License-Identifier: Apache-2.0

description: |
    Infineon CYW43 Bluetooth HCI over the shared gSPI bus.

    On the Raspberry Pi Pico W / Pico 2 W the CYW43439's Bluetooth controller is
    not reachable over a UART (see infineon,bt-hci-uart) — HCI/ACL is carried
    over the same gSPI bus as WiFi. This node sits as a child of the
    infineon,airoc-wifi node and drives the controller through the AIROC/WHD
    driver's backplane accessors.

    Example:

      airoc-wifi@0 {
        compatible = "infineon,airoc-wifi";
        ...
        cyw43_bt_hci: cyw43_bt_hci {
          compatible = "infineon,cyw43-bt-hci";
        };
      };

    and point the host at it:

      chosen {
        zephyr,bt-hci = &cyw43_bt_hci;
      };

    NOTE: requires the BT controller patchram from the georgerobotics
    cyw43-driver submodule of hal_rpi_pico:
      git -C modules/hal/rpi_pico submodule update --init lib/cyw43-driver

compatible: "infineon,cyw43-bt-hci"

include: bt-hci.yaml
```

## dts/bindings/i2s/zephyr,i2s-sdl.yaml
```yaml
# Copyright (c) 2026 Adafruit Industries
# SPDX-License-Identifier: Apache-2.0

description: SDL based emulated I2S controller for native_sim

compatible: "zephyr,i2s-sdl"

include: base.yaml
```

## dts/bindings/test/vnd,dac.yaml
```yaml
# Copyright (c) 2024 TOKITA Hiroshi
# SPDX-License-Identifier: Apache-2.0

description: Test DAC node

compatible: "vnd,dac"

include: dac-controller.yaml

properties:
  "#io-channel-cells":
    const: 1

  vref-mv:
    type: int
    default: 0
    description: |
      Reference voltage in millivolts. When set, DAC writes are recorded on
      the perfetto counter tracks in millivolts (converted from the written
      code through this reference). When 0, tracks record the raw code.

io-channel-cells:
  - output
```
