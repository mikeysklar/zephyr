/*
 * Copyright (c) 2025 Adafruit Industries LLC
 *
 * SPDX-License-Identifier: Apache-2.0
 */

/dts-v1/;
#include "adafruit_clue_nrf52840_common.dtsi"
#include <nordic/nrf52840_partition_uf2_sdv6.dtsi>
#include <../boards/common/usb/cdc_acm_serial.dtsi>

/ {
	model = "Adafruit CLUE nRF52840 Express";
	compatible = "adafruit,clue-nrf52840-uf2";
};
