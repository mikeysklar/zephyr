## boards/adafruit/metro_ch32v4x7/Kconfig.adafruit_metro_ch32v407
```kconfig
# Copyright (c) 2026 Adafruit Industries
# SPDX-License-Identifier: Apache-2.0

config BOARD_ADAFRUIT_METRO_CH32V407
	select SOC_CH32V407
```

## boards/adafruit/metro_ch32v4x7/board.yml
```yaml
# Copyright (c) 2026 Adafruit Industries
# SPDX-License-Identifier: Apache-2.0

boards:
  - name: adafruit_metro_ch32v407
    full_name: Adafruit Metro CH32V407
    vendor: adafruit
    socs:
      - name: ch32v407
  - name: adafruit_metro_ch32v467
    full_name: Adafruit Metro CH32V467
    vendor: adafruit
    socs:
      - name: ch32v467
```

## drivers/usb/udc/Kconfig.wch_usbhs2
```kconfig
# Copyright (c) 2026 Adafruit Industries
# SPDX-License-Identifier: Apache-2.0

config UDC_WCH_USBHS2
	bool "WCH USBHS (second generation) device controller driver"
	default y
	depends on DT_HAS_WCH_USBHS2_ENABLED
	select EVENTS
	select UDC_DRIVER_HAS_HIGH_SPEED_SUPPORT
	help
	  Driver for the WCH second generation USBHS device controller found
	  on the CH32V4x7.

if UDC_WCH_USBHS2

config UDC_WCH_USBHS2_STACK_SIZE
	int "UDC controller driver internal thread stack size"
	default 512
	help
	  Device controller driver internal thread stack size.

config UDC_WCH_USBHS2_THREAD_PRIORITY
	int "UDC controller driver thread priority"
	default 8
	help
	  Device controller driver thread priority.

endif # UDC_WCH_USBHS2
```

## dts/bindings/clock/wch,ch32v4x7-pll-clock.yaml
```yaml
# Copyright (c) 2026 Adafruit Industries
# SPDX-License-Identifier: Apache-2.0

description: |
  WCH CH32V4x7 system PLL

  The PLL multiplies HSE or HSI to SYSCLK. The core and bus clock (HCLK) is
  SYSCLK / 2, so set the CPU clock-frequency to half of the PLL output.
  For example, a 25 MHz HSE with mul = 16 gives SYSCLK = 400 MHz and
  HCLK = 200 MHz.

compatible: "wch,ch32v4x7-pll-clock"

include: [clock-controller.yaml, base.yaml]

properties:
  "#clock-cells":
    const: 0

  clocks:
    type: phandle-array
    required: true

  mul:
    type: int
    required: true
    description: |
      PLL multiplication factor.
    enum:
      - 8
      - 9
      - 10
      - 11
      - 12
      - 13
      - 14
      - 15
      - 16
      - 17
      - 18
      - 19
      - 20
      - 21
      - 22
      - 24
      - 26
      - 28
      - 30
      - 32
      - 34
      - 36
      - 38
      - 40
```

## dts/bindings/cpu/wch,qingke-v3v.yaml
```yaml
# Copyright (c) 2026 Adafruit Industries
# SPDX-License-Identifier: Apache-2.0

description: WCH QingKe V3V RISC-V MCU

compatible: "wch,qingke-v3v"

include: riscv-common.yaml
```

## dts/bindings/usb/wch,usbhs2.yaml
```yaml
# Copyright (c) 2026 Adafruit Industries
# SPDX-License-Identifier: Apache-2.0

description: |
  WCH second generation USB 2.0 high speed device controller (USBHS1 and
  USBHS2 on the CH32V4x7). Its UTMI PHY runs from the USBHS PLL, which is
  fed by HSE.

compatible: "wch,usbhs2"

include: usb-ep.yaml

properties:
  reg:
    required: true

  interrupts:
    required: true

  clocks:
    required: true
```

## soc/wch/ch32v/ch32v4x7/Kconfig.soc.ch32v407
```kconfig
# Copyright (c) 2026 Adafruit Industries
# SPDX-License-Identifier: Apache-2.0

config SOC_CH32V407
	bool
	select SOC_SERIES_CH32V4X7

config SOC
	default "ch32v407" if SOC_CH32V407
```

## soc/wch/ch32v/ch32v4x7/Kconfig.soc.ch32v467
```kconfig
# Copyright (c) 2026 Adafruit Industries
# SPDX-License-Identifier: Apache-2.0

config SOC_CH32V467
	bool
	select SOC_SERIES_CH32V4X7

config SOC
	default "ch32v467" if SOC_CH32V467
```
